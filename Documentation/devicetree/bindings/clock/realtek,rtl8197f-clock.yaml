## Documentation/devicetree/bindings/clock/realtek,rtl8197f-clock.yaml
```yaml
# SPDX-License-Identifier: GPL-2.0-only OR BSD-2-Clause
%YAML 1.2
---
$id: http://devicetree.org/schemas/clock/realtek,rtl8197f-clock.yaml#
$schema: http://devicetree.org/meta-schemas/core.yaml#

title: Realtek RTL8197F SoC clock controller

maintainers:
  - David Yang <mmyangfl@gmail.com>

description: |
  This node is a child of the system controller (see
  Documentation/devicetree/bindings/soc/realtek/realtek,rtl8197f-syscon.yaml),
  so its reg is relative to the system controller window.

  The RTL8197F system controller holds the hardware strap register that
  multiplexes and divides the CPU clock, the crystal-select strap bit,
  and the WLAN clock/function gate.  The straps are read-only; the
  WLAN gate is programmable, because the integrated WiFi core cannot be
  accessed at all while it is closed.

properties:
  compatible:
    const: realtek,rtl8197f-clock

  reg:
    maxItems: 1

  '#clock-cells':
    const: 1

required:
  - compatible
  - reg
  - '#clock-cells'

additionalProperties: false

examples:
  - |
    syscon@18000000 {
        compatible = "realtek,rtl8197f-syscon", "syscon", "simple-mfd";
        reg = <0x18000000 0x200>;
        #address-cells = <1>;
        #size-cells = <1>;
        ranges = <0x0 0x18000000 0x200>;

        clock-controller@0 {
            compatible = "realtek,rtl8197f-clock";
            /* strap at 0x08, WLAN clock/function gate at 0x64 */
            reg = <0x0 0x68>;
            #clock-cells = <1>;
        };
    };
```

## Documentation/devicetree/bindings/gpio/realtek,rtl8197f-gpio.yaml
```yaml
# SPDX-License-Identifier: (GPL-2.0-only OR BSD-2-Clause)
%YAML 1.2
---
$id: http://devicetree.org/schemas/gpio/realtek,rtl8197f-gpio.yaml#
$schema: http://devicetree.org/meta-schemas/core.yaml#

title: Realtek RTL8197F GPIO controller

maintainers:
  - David Yang <mmyangfl@gmail.com>

description: |
  The RTL8197F provides two identical banks of 32 GPIOs, known in the vendor
  documentation as ports ABCD (bank 0, at 0x18003500) and EFGH (bank 1, at
  0x1800351c).  Each bank is a separate device node with its own interrupt
  line cascading from the SoC interrupt controller (realtek,rtl8197f-intc),
  inputs 16 (ports ABCD) and 17 (ports EFGH) respectively.

  Interrupts are edge triggered only (rising, falling or both edges); level
  triggered interrupts are not implemented in hardware.  Interrupt children
  must specify their trigger type explicitly (an unspecified trigger leaves
  the pin's interrupt mask bit clear and the interrupt silent).

  There is no pinctrl hardware on this SoC: pin muxing is done by writing to
  global system registers and is not managed by this controller.  Some pins
  (notably parts of ports B and H) are muxed with the switch LED outputs and
  must not be claimed as GPIOs when LED output is required.

  All 32 pins of each bank are exposed unconditionally.  The vendor BSP
  marks a number of pins as output-only and leaves some port H pins with
  no mux table entry at all; claiming such a pin as an input silently
  reads back undefined levels.  Board device trees must only reference
  pins known to be wired as GPIOs.

properties:
  compatible:
    const: realtek,rtl8197f-gpio

  reg:
    maxItems: 1

  gpio-controller: true

  "#gpio-cells":
    const: 2

  interrupt-controller: true

  "#interrupt-cells":
    const: 2

  interrupts:
    maxItems: 1
    description: Interrupt line of this bank in the parent SoC interrupt
      controller (input 16 for bank 0, input 17 for bank 1).

required:
  - compatible
  - reg
  - gpio-controller
  - "#gpio-cells"

allOf:
  - if:
      required: [interrupt-controller]
    then:
      required:
        - "#interrupt-cells"
        - interrupts

additionalProperties: false

examples:
  - |
    gpio0: gpio@3500 {
      compatible = "realtek,rtl8197f-gpio";
      reg = <0x3500 0x1c>;

      gpio-controller;
      #gpio-cells = <2>;

      interrupt-controller;
      #interrupt-cells = <2>;

      interrupt-parent = <&intc>;
      interrupts = <16 0>;
    };

    gpio1: gpio@351c {
      compatible = "realtek,rtl8197f-gpio";
      reg = <0x351c 0x1c>;

      gpio-controller;
      #gpio-cells = <2>;

      interrupt-controller;
      #interrupt-cells = <2>;

      interrupt-parent = <&intc>;
      interrupts = <17 0>;
    };

...
```

## Documentation/devicetree/bindings/interrupt-controller/realtek,rtl8197f-intc.yaml
```yaml
# SPDX-License-Identifier: (GPL-2.0-only OR BSD-2-Clause)
%YAML 1.2
---
$id: http://devicetree.org/schemas/interrupt-controller/realtek,rtl8197f-intc.yaml#
$schema: http://devicetree.org/meta-schemas/core.yaml#

title: Realtek RTL819x SoC interrupt controller

maintainers:
  - David Yang <mmyangfl@gmail.com>

description: |
  Secondary interrupt controller found in the Realtek RTL819x MIPS router
  SoCs (RTL8197F and relatives), cascaded into a MIPS CPU interrupt
  controller (mti,cpu-interrupt-controller).  It has 64 inputs, split into
  two banks of 32, each with its own mask (GIMR/GIMR2) and status
  (GISR/GISR2) register.  Bank 1 is aggregated onto bank 0 input 31, which
  is therefore reserved and not usable as a regular interrupt.

  Eight routing registers (IRR0-IRR7) assign each input to one of the six
  MIPS CPU interrupt lines IP2-IP7; the routing of an input is selected by
  the second cell of its interrupt specifier.  The node must list one
  parent interrupt for every CPU line that routed inputs land on: on the
  RTL8197F these are IP2 (generic sources), IP4 (switch core), IP5 (PCIe),
  IP6 (WLAN MAC) and IP7 (CPU SI timer).

allOf:
  - $ref: /schemas/interrupt-controller.yaml#

properties:
  compatible:
    const: realtek,rtl8197f-intc

  reg:
    maxItems: 1

  interrupt-controller: true

  "#address-cells":
    const: 0

  "#interrupt-cells":
    const: 2
    description: |
      The first cell is the interrupt input number (0-63, input 31
      reserved).  The second cell is the index of the parent interrupt in
      "interrupts" whose CPU line the input is wired to; inputs are
      level-high, no trigger-type configuration is provided.

  interrupts:
    minItems: 1
    maxItems: 5
    description:
      The MIPS CPU interrupt lines this controller feeds, in the order
      referenced by the second cell of the interrupt specifiers.

required:
  - compatible
  - reg
  - interrupt-controller
  - "#interrupt-cells"
  - interrupts

additionalProperties: false

examples:
  - |
    rtl8197f_intc: interrupt-controller@3000 {
        compatible = "realtek,rtl8197f-intc";
        reg = <0x3000 0x40>;
        interrupt-controller;
        #interrupt-cells = <2>;
        interrupt-parent = <&cpuintc>;
        interrupts = <2>, <4>, <5>, <6>, <7>;
    };

    device {
        interrupt-parent = <&rtl8197f_intc>;
        interrupts = <9 0>; /* UART0, routed to the first parent (IP2) */
    };
```

## Documentation/devicetree/bindings/mips/realtek-rtl819x.yaml
```yaml
# SPDX-License-Identifier: GPL-2.0-only OR BSD-2-Clause
%YAML 1.2
---
$id: http://devicetree.org/schemas/mips/realtek-rtl819x.yaml#
$schema: http://devicetree.org/meta-schemas/core.yaml#

title: Realtek RTL819x SoC series

maintainers:
  - David Yang <mmyangfl@gmail.com>

description: |
  The RTL819x family are Realtek's wireless router SoCs, based on a
  little-endian MIPS 24KEc class CPU, distinct from the RTL83xx/93xx
  (Otto) switch SoC series.

properties:
  $nodename:
    const: "/"
  compatible:
    oneOf:
      # RTL8197F-based boards
      - items:
          - enum:
              - netcore,mg1200ac
          - const: realtek,rtl8197f-soc

additionalProperties: true
```

## Documentation/devicetree/bindings/net/realtek,rtl8197f-eth.yaml
```yaml
# SPDX-License-Identifier: GPL-2.0-only OR BSD-2-Clause
%YAML 1.2
---
$id: http://devicetree.org/schemas/net/realtek,rtl8197f-eth.yaml#
$schema: http://devicetree.org/meta-schemas/core.yaml#

title: Realtek RTL8197F Ethernet MAC / embedded switch CPU interface

maintainers:
  - David Yang <mmyangfl@gmail.com>

description: |
  The RTL8197F integrates a 5+1 port Ethernet switch whose CPU port is served
  by a DMA engine (the "NIC" or "CPU interface" block).  The MAC has no
  per-port PHY management of its own: the embedded switch is expected to be
  set up by the bootloader (port enable, VLAN / port isolation, CPU port
  mapping), and this node only programs the DMA descriptor rings used to
  exchange packets with the switch over the CPU port.

  Packets received from the CPU port carry no Ethernet switch tag by default
  and are directed by the switch configuration; the destination port mask
  used on transmit can be selected with realtek,tx-portmask.

properties:
  compatible:
    const: realtek,rtl8197f-eth

  reg:
    maxItems: 1
    description:
      CPU interface (NIC DMA) register block, offset 0x10000 from the system
      controller base (physical 0x18010000 on RTL8197F).

  reg-names:
    const: nic

  interrupts:
    maxItems: 1
    description:
      Switch/CPU-interface interrupt on the SoC interrupt controller
      (intc input 15, routed to CPU interrupt input 4).

  realtek,tx-portmask:
    $ref: /schemas/types.yaml#/definitions/uint32
    maximum: 0x7f
    description:
      Destination port mask written to the Tx descriptor (TD_DP field,
      bit 6 = CPU port, bits 5..0 = physical/ext. ports 5..0) for directly
      transmitted packets when no hardware offload path is used.  If absent,
      all switch ports (0x3f) are addressed, which relies on the bootloader
      switch configuration to forward/flood appropriately.

required:
  - compatible
  - reg
  - reg-names
  - interrupts

allOf:
  - $ref: ethernet-controller.yaml#

unevaluatedProperties: false

examples:
  - |
    ethernet@18010000 {
      compatible = "realtek,rtl8197f-eth";
      reg = <0x18010000 0x100>;
      reg-names = "nic";
      interrupt-parent = <&intc>;
      interrupts = <15 1>;

      realtek,tx-portmask = <0x1>;
      local-mac-address = [00 11 22 33 44 55];
    };
...
```

## Documentation/devicetree/bindings/net/wireless/realtek,rtl8197f-wifi.yaml
```yaml
# SPDX-License-Identifier: GPL-2.0-only OR BSD-2-Clause
%YAML 1.2
---
$id: http://devicetree.org/schemas/net/wireless/realtek,rtl8197f-wifi.yaml#
$schema: http://devicetree.org/meta-schemas/core.yaml#

title: Realtek RTL8197F integrated 802.11bgn WiFi

maintainers:
  - David Yang <mmyangfl@gmail.com>

description: |
  The RTL8197F router SoC integrates an 802.11bgn 1T1R WiFi core of the
  Realtek RTL8192F (gen-2.5) family.  The core is wired directly to the
  SoC bus (not enumerated on the internal PCIe controller) and uses a
  PCI-style descriptor DMA engine.

  The MAC address is looked up in this order: a DT property (see
  mac-address / local-mac-address below, which the bootloader or a
  packaging layer can fill in from the factory MIB stored in flash), then
  the on-die eFuse, then a randomly generated locally administered address.

  Transmit power is programmed per channel from the same record.  It is
  taken whole, as one cell, and indexed by the driver: bytes 0..5 are the
  interface address, 48..61 and 62..75 the CCK levels of the two paths,
  76..89 and 90..103 the HT40 levels, 104..145 the signed per-channel
  differences for HT40 dual-stream, HT20 and OFDM (two 4-bit steps per
  byte), and 146..162 the regulatory domain, RFE type, crystal trim and
  thermal-tracking flag.  Every level byte of 0 means the board stores no
  level for that channel and the driver uses its default.

properties:
  compatible:
    const: realtek,rtl8197f-wifi

  reg:
    maxItems: 1

  interrupts:
    maxItems: 1

  clocks:
    items:
      - description:
          WLAN clock/function gate in the SoC system controller.  The core
          registers read back as zero while it is closed.
      - description:
          Crystal reference fed to the core, either 25 MHz or 40 MHz, which
          the core's analog front end has to be told about.

  clock-names:
    items:
      - const: core
      - const: ref

  mac-address: true

  local-mac-address: true

  nvmem-cells:
    description:
      Board efuse record - the factory calibration block of this interface,
      typically a cell of the MIB partition on the SPI NOR flash this SoC
      boots from.  At least 163 bytes; see the layout above.
    maxItems: 1

  nvmem-cell-names:
    const: efuse

required:
  - compatible
  - reg
  - interrupts
  - clocks
  - clock-names

additionalProperties: false

examples:
  - |
    #include <dt-bindings/clock/realtek-rtl819x-clks.h>

    wifi@18640000 {
        compatible = "realtek,rtl8197f-wifi";
        reg = <0x18640000 0x10000>;
        clocks = <&sysclk RTL8197F_CLK_WLAN>,
                 <&sysclk RTL8197F_CLK_WIFI_REF>;
        clock-names = "core", "ref";
        interrupt-parent = <&intc>;
        interrupts = <29 4>;
        local-mac-address = [00 11 22 33 44 55];
    };
```

## Documentation/devicetree/bindings/pci/realtek,rtl8197f-pcie.yaml
```yaml
# SPDX-License-Identifier: (GPL-2.0-only OR BSD-2-Clause)
%YAML 1.2
---
$id: http://devicetree.org/schemas/pci/realtek,rtl8197f-pcie.yaml#
$schema: http://devicetree.org/meta-schemas/core.yaml#

title: Realtek RTL819x PCIe controller

maintainers:
  - David Yang <mmyangfl@gmail.com>

description: |
  The RTL819x family of wireless router SoCs (RTL8196E, RTL8197D,
  RTL8197F, ...) contains a single PCIe 1.1 root port, normally used to
  attach the on-board wireless card.

  The root port configuration space is memory mapped directly;
  configuration accesses to downstream devices are routed through an
  indexed window selected by the IPCFG register.  The PCIe PHY is
  programmed over a private MDIO bus before the link comes up; the
  clock, reset and PERST# bits live in the shared system controller.

allOf:
  - $ref: /schemas/pci/pci-host-bridge.yaml#

properties:
  compatible:
    const: realtek,rtl8197f-pcie

  reg:
    maxItems: 3

  reg-names:
    items:
      - const: rc_cfg
      - const: ep_cfg
      - const: rc_ext

  ranges: true

  syscon:
    $ref: /schemas/types.yaml#/definitions/phandle
    description:
      Phandle to the system controller holding the PCIe clock enables,
      resets, PERST# bit and PHY MDIO reset.

  interrupts:
    maxItems: 1
    description:
      Shared legacy INTA#/INTB#/INTC#/INTD# interrupt of the root port.
      This is input 21 of the SoC interrupt controller (routed to CPU
      IP5 inside the controller) and must be described through that
      controller's domain.  The CPU interrupt lines are chained
      handlers owned by the interrupt controller and cannot be
      requested directly.

  "#interrupt-cells":
    const: 1

  interrupt-map-mask:
    items:
      - const: 0
      - const: 0
      - const: 0
      - const: 7

  interrupt-map:
    maxItems: 4

required:
  - compatible
  - reg
  - reg-names
  - ranges
  - syscon
  - interrupts

unevaluatedProperties: false

examples:
  - |
    pcie@18b00000 {
        compatible = "realtek,rtl8197f-pcie";
        reg = <0x18b00000 0x1000>, <0x18b10000 0x1000>, <0x18b01000 0x100>;
        reg-names = "rc_cfg", "ep_cfg", "rc_ext";
        ranges = <0x02000000 0 0x19000000 0x19000000 0 0xc00000>;
        syscon = <&syscon>;

        interrupt-parent = <&intc>;
        interrupts = <21 2>;
        interrupt-map-mask = <0 0 0 7>;
        interrupt-map = <0 0 0 1 &intc 21 4>,
                        <0 0 0 2 &intc 21 4>,
                        <0 0 0 3 &intc 21 4>,
                        <0 0 0 4 &intc 21 4>;

        #address-cells = <3>;
        #size-cells = <2>;
        #interrupt-cells = <1>;
        device_type = "pci";
    };
...
```
