## Documentation/devicetree/bindings/phy/realtek,rtl8197f-usbphy.yaml
```yaml
# SPDX-License-Identifier: (GPL-2.0-only OR BSD-2-Clause)
%YAML 1.2
---
$id: http://devicetree.org/schemas/phy/realtek,rtl8197f-usbphy.yaml#
$schema: http://devicetree.org/meta-schemas/core.yaml#

title: Realtek RTL819x USB 2.0 PHY

maintainers:
  - David Yang <mmyangfl@gmail.com>

description: |
  The RTL8197F (and other RTL819x SoCs) integrate two UTMI USB 2.0 PHYs.
  Both PHYs are shared by the on-chip EHCI and OHCI host controllers; PHY 1
  can alternatively be routed to the DWC OTG device controller.  Power and
  reset of the PHYs is controlled through the system controller, while the
  electrical parameters are written through an indirect access port made of
  a data register in the USB analog block and an address strobe register
  inside the EHCI MMIO space.

properties:
  compatible:
    const: realtek,rtl8197f-usbphy

  reg:
    items:
      - description: USB analog block registers (UTMI data / port control)
      - description: UTMI address strobe register (EHCI MMIO offset 0xa4)

  reg-names:
    items:
      - const: analog
      - const: utmi-acc

  syscon:
    $ref: /schemas/types.yaml#/definitions/phandle
    description:
      Phandle to the system controller node (realtek,rtl8197f-syscon),
      providing the USB clock gate, host enable, PHY power/reset and SIE
      routing registers.

  "#phy-cells":
    const: 1
    description: The USB port (UTMI PHY) index, 0 or 1.

required:
  - compatible
  - reg
  - reg-names
  - syscon
  - "#phy-cells"

additionalProperties: false

examples:
  - |
    usb-phy@140200 {
        compatible = "realtek,rtl8197f-usbphy";
        reg = <0x140200 0x18>, <0x210a4 0x4>;
        reg-names = "analog", "utmi-acc";
        syscon = <&syscon>;
        #phy-cells = <1>;
    };
```

## Documentation/devicetree/bindings/serial/realtek,rtl8197f-uart.yaml
```yaml
# SPDX-License-Identifier: GPL-2.0-only OR BSD-2-Clause
%YAML 1.2
---
$id: http://devicetree.org/schemas/serial/realtek,rtl8197f-uart.yaml#
$schema: http://devicetree.org/meta-schemas/core.yaml#

title: Realtek RTL8197F UART

maintainers:
  - David Yang <mmyangfl@gmail.com>

description: |
  The RTL8197F integrates a DesignWare APB UART whose register file is
  word-strided like a regular 8250 with reg-shift = 2, but the TX/RX
  FIFO register is placed at offset 0x24 instead of 0x00, so it is not
  covered by the generic snps,dw-apb-uart binding.

allOf:
  - $ref: serial.yaml#

properties:
  compatible:
    const: realtek,rtl8197f-uart

  reg:
    maxItems: 1

  interrupts:
    maxItems: 1

  clocks:
    maxItems: 1
    description:
      Optional bus clock; when absent the driver falls back to
      clock-frequency.

  clock-frequency: true

  reg-shift:
    const: 2

required:
  - compatible
  - reg
  - interrupts
  - clock-frequency

unevaluatedProperties: false

examples:
  - |
    serial@18147000 {
        compatible = "realtek,rtl8197f-uart";
        reg = <0x18147000 0x100>;
        interrupts = <9 4>;
        interrupt-parent = <&intc>;
        clock-frequency = <100000000>;
        reg-shift = <2>;
    };
```

## Documentation/devicetree/bindings/soc/realtek/realtek,rtl8197f-switch.yaml
```yaml
# SPDX-License-Identifier: (GPL-2.0-only OR BSD-2-Clause)
%YAML 1.2
---
$id: http://devicetree.org/schemas/soc/realtek/realtek,rtl8197f-switch.yaml#
$schema: http://devicetree.org/meta-schemas/core.yaml#

title: Realtek RTL8197F embedded Ethernet switch

maintainers:
  - David Yang <mmyangfl@gmail.com>

description: |
  The RTL8197F contains a 5+1 port Ethernet switch at a dedicated bus
  window outside the internal peripheral bus.  No switch management
  (L2, VLAN, offload) is implemented; the bootloader leaves the switch
  configured.  The node only exists so that the register window is
  claimed and the minimal bring-up steps the CPU-port NIC
  (realtek,rtl8197f-eth) depends on are performed; it must be enabled
  whenever the Ethernet MAC is used.

  The CPU interface is a port of this switch, not a netdevice of its own:
  frames it forwards only reach the host through the Ethernet MAC wired to
  it, which is why the CPU port names that MAC with an "ethernet" phandle.

properties:
  compatible:
    const: realtek,rtl8197f-switch

  reg:
    maxItems: 1

  ports:
    type: object
    additionalProperties: false
    properties:
      "#address-cells":
        const: 1
      "#size-cells":
        const: 0
    patternProperties:
      '^port@[0-9]$':
        type: object
        description: CPU interface port of the switch.
        additionalProperties: false
        properties:
          reg:
            description: Logical port number (the CPU interface is port 8).
            minItems: 1
            maxItems: 1
          ethernet:
            $ref: /schemas/types.yaml#/definitions/phandle
            description:
              phandle of the Ethernet MAC (realtek,rtl8197f-eth) that carries
              this port's frames; the driver arms the switch-side descriptor
              trigger for that interface.
        required:
          - reg
          - ethernet
    required:
      - "#address-cells"
      - "#size-cells"

required:
  - compatible
  - reg
  - ports

additionalProperties: false

examples:
  - |
    switch@1b800000 {
        compatible = "realtek,rtl8197f-switch";
        reg = <0x1b800000 0x500000>;

        ports {
            #address-cells = <1>;
            #size-cells = <0>;

            port@8 {
                reg = <8>;
                ethernet = <&eth0>;
            };
        };
    };
...
```

## Documentation/devicetree/bindings/soc/realtek/realtek,rtl8197f-syscon.yaml
```yaml
# SPDX-License-Identifier: (GPL-2.0-only OR BSD-2-Clause)
%YAML 1.2
---
$id: http://devicetree.org/schemas/soc/realtek/realtek,rtl8197f-syscon.yaml#
$schema: http://devicetree.org/meta-schemas/core.yaml#

title: Realtek RTL8197F system controller

maintainers:
  - David Yang <mmyangfl@gmail.com>

description: |
  The RTL8197F system controller bundles miscellaneous SoC-wide registers
  (pin multiplexing, bus and clock gates, strap options) behind a single
  register window at 0x18000000.  It is exposed as a syscon so that
  drivers for blocks without a dedicated region of their own (USB PHY,
  PCIe) can reach the few registers they need.

properties:
  compatible:
    items:
      - const: realtek,rtl8197f-syscon
      - const: syscon
      - const: simple-mfd

  reg:
    maxItems: 1

  "#address-cells":
    const: 1

  "#size-cells":
    const: 1

  ranges:
    maxItems: 1

patternProperties:
  '^clock-controller@[0-9a-f]+$':
    $ref: /schemas/clock/realtek,rtl8197f-clock.yaml

required:
  - compatible
  - reg

additionalProperties: false

examples:
  - |
    syscon@0 {
        compatible = "realtek,rtl8197f-syscon", "syscon",
                     "simple-mfd";
        reg = <0x0 0x200>;
        #address-cells = <1>;
        #size-cells = <1>;
        ranges = <0x0 0x0 0x200>;

        clock-controller@0 {
            compatible = "realtek,rtl8197f-clock";
            reg = <0x0 0x68>;
            #clock-cells = <1>;
        };
    };
...
```

## Documentation/devicetree/bindings/spi/realtek,rtl8197f-spi.yaml
```yaml
# SPDX-License-Identifier: (GPL-2.0-only OR BSD-2-Clause)
%YAML 1.2
---
$id: http://devicetree.org/schemas/spi/realtek,rtl8197f-spi.yaml#
$schema: http://devicetree.org/meta-schemas/core.yaml#

title: Realtek RTL8197F SPI flash controller

maintainers:
  - David Yang <mmyangfl@gmail.com>

description: |
  The RTL8197F (and other RTL819x SoCs) contain a SPI flash controller
  derived from the Synopsys DesignWare SSI, located at 0x18143000.  It is a
  half-duplex, single-lane controller intended to drive a SPI NOR flash
  chip, and works together with the SPI NOR framework (jedec,spi-nor).

  The register layout follows the DesignWare APB SSI, but the transfer
  engine carries vendor extensions and silicon quirks (flash-extension
  registers, NDF frame-count semantics, unreliable RXFLR) which make it
  incompatible with a plain DesignWare SSI in software.  It therefore
  carries no "snps,dw-apb-ssi" fallback compatible and is driven by
  drivers/spi/spi-realtek-rtl819x.c, which reuses the DesignWare core for the
  host registration but replaces its mem-ops transfer engine.

  This controller is unrelated to the simpler SPI flash controller found in
  the Realtek Otto SoCs (RTL8380/8382/8391/8392/8393), which has a
  completely different register layout and uses the "realtek,rtl8380-spi"
  family of compatibles.

allOf:
  - $ref: spi-controller.yaml#

properties:
  compatible:
    const: realtek,rtl8197f-spi

  reg:
    maxItems: 1

  interrupts:
    maxItems: 1

  clocks:
    maxItems: 1

  num-cs:
    description: Number of chip selects, up to 16.
    $ref: /schemas/types.yaml#/definitions/uint32
    minimum: 1
    maximum: 16
    default: 1

required:
  - compatible
  - reg
  - clocks
  - "#address-cells"
  - "#size-cells"

unevaluatedProperties: false

examples:
  - |
    #include <dt-bindings/clock/realtek-rtl819x-clks.h>

    syscon@18000000 {
        compatible = "realtek,rtl8197f-syscon", "syscon", "simple-mfd";
        reg = <0x18000000 0x200>;
        #address-cells = <1>;
        #size-cells = <1>;
        ranges = <0x0 0x18000000 0x200>;

        sysclk: clock-controller@0 {
            compatible = "realtek,rtl8197f-clock";
            reg = <0x0 0x68>;
            #clock-cells = <1>;
        };
    };

    spi0: spi@18143000 {
        compatible = "realtek,rtl8197f-spi";
        reg = <0x18143000 0x1000>;
        clocks = <&sysclk RTL8197F_CLK_SPI>;
        num-cs = <1>;
        #address-cells = <1>;
        #size-cells = <0>;

        flash@0 {
            compatible = "jedec,spi-nor";
            reg = <0>;
            /* the vendor-validated SPI clock / 8 */
            spi-max-frequency = <12500000>;

            partitions {
                compatible = "fixed-partitions";
                #address-cells = <1>;
                #size-cells = <1>;

                partition@0 {
                    label = "boot";
                    reg = <0x0 0x40000>;
                    read-only;
                };

                partition@40000 {
                    label = "firmware";
                    reg = <0x40000 0x1fc0000>;
                };
            };
        };
    };
...
```

## Documentation/devicetree/bindings/timer/realtek,rtl8197f-timer.yaml
```yaml
# SPDX-License-Identifier: GPL-2.0-only OR BSD-2-Clause
%YAML 1.2
---
$id: http://devicetree.org/schemas/timer/realtek,rtl8197f-timer.yaml#
$schema: http://devicetree.org/meta-schemas/core.yaml#

title: Realtek RTL8197F SoC timer

maintainers:
  - David Yang <mmyangfl@gmail.com>

description: |
  The RTL8197F contains a timer block with a shared pre-divider (which it
  shares with the watchdog), two timer channels and per-channel interrupt
  enable and status bits.  TIMER0 drives the system clock event device:
  the CPU only raises the CP0 Compare condition as Cause.TI and never
  asserts it on an interrupt line.

  The register window includes the shared pre-divider (CDBR, +0x18).
  This node owns CDBR and programs it for the timer input; the watchdog
  node overlaps it at +0x18 but only reads the divider back.

properties:
  compatible:
    const: realtek,rtl8197f-timer

  reg:
    maxItems: 1

  interrupts:
    maxItems: 1

  clocks:
    maxItems: 1

  clock-frequency: true

required:
  - compatible
  - reg
  - interrupts

oneOf:
  - required: [clocks]
  - required: [clock-frequency]

unevaluatedProperties: false

examples:
  - |
    timer@3100 {
        compatible = "realtek,rtl8197f-timer";
        reg = <0x3100 0x20>;
        interrupt-parent = <&intc>;
        interrupts = <7 4>;
        clock-frequency = <200000000>;
    };
```

## Documentation/devicetree/bindings/watchdog/realtek,rtl8197f-wdt.yaml
```yaml
# SPDX-License-Identifier: GPL-2.0-only OR BSD-2-Clause
%YAML 1.2
---
$id: http://devicetree.org/schemas/watchdog/realtek,rtl8197f-wdt.yaml#
$schema: http://devicetree.org/meta-schemas/core.yaml#

title: Realtek RTL8197F watchdog timer

maintainers:
  - David Yang <mmyangfl@gmail.com>

description: |
  The RTL8197F and related RTL819x SoCs have a watchdog timer in the shared
  timer register block. The register range covered by this node spans the
  timer clock divider register (CDBR, +0x18) and the watchdog control
  register (+0x1c). CDBR is owned and programmed by the timer node
  (realtek,rtl8197f-timer); this node only reads the divider back to
  convert between ticks and seconds, so the timer must be probed first.
  The watchdog has no interrupt and always resets the whole SoC when it
  times out. It is also used to perform system restarts.

allOf:
  - $ref: watchdog.yaml#

properties:
  compatible:
    const: realtek,rtl8197f-wdt

  reg:
    maxItems: 1

  clocks:
    maxItems: 1

required:
  - compatible
  - reg
  - clocks

unevaluatedProperties: false

examples:
  - |
    watchdog@3118 {
        compatible = "realtek,rtl8197f-wdt";
        reg = <0x3118 0x8>;

        clocks = <&lxbus_clock>;
        timeout-sec = <30>;
    };

...
```
